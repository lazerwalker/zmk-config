## config/west.yml
```yaml
manifest:
  remotes:
    - name: lazerwalker
      url-base: https://github.com/lazerwalker
  projects:
    - name: zmk
      remote: lazerwalker
      revision: multiple-features
      import: app/west.yml
  self:
    path: config
```
